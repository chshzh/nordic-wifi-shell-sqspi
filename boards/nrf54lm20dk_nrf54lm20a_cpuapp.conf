## boards/nrf54lm20dk_nrf54lm20a_cpuapp.conf
```kconfig
# Copyright (c) 2026 Nordic Semiconductor ASA
# SPDX-License-Identifier: LicenseRef-Nordic-5-Clause

# Wi-Fi credentials storage (ZMS-backed settings)
CONFIG_WIFI_CREDENTIALS=y
CONFIG_FLASH=y
CONFIG_FLASH_PAGE_LAYOUT=y
CONFIG_FLASH_MAP=y
CONFIG_ZMS=y
CONFIG_SETTINGS=y

# Increase log buffer for MSPI bus debug output
CONFIG_LOG_BUFFER_SIZE=8192

# Use random MAC address (OTP MAC is FF:FF:FF:FF:FF:FF on dev boards)
CONFIG_WIFI_RANDOM_MAC_ADDRESS=y
```

## west.yml
```yaml
manifest:
  version: "0.10"

  # Use sdk-nrf as the manifest source; import: true pulls in all NCS
  # dependencies transitively (zephyr with west-commands + west.yml import for
  # hal_nordic etc., nrfxlib, modules, bootloader…).
  #
  # DO NOT explicitly list zephyr or nrfxlib here — doing so overrides the entry
  # from nrf's transitive import and loses zephyr's own import: allowlist, which
  # is what registers 'west build' and fetches hal_nordic and other modules.
  #
  # wfa-qt-control-app, qcbor, cmock, coremark are external repos that fail to
  # fetch specific commit SHAs in CI. They are not needed for the wifi-shell
  # build. We assign them to the 'ci-skip' group and disable it via west config.
  projects:
    - name: nrf
      url: https://github.com/nrfconnect/sdk-nrf
      revision: v3.3.0
      import: true

  # Tell west that this app lives at nordic-wifi-shell-sqspi/ in the workspace.
  self:
    path: nordic-wifi-shell-sqspi
```
